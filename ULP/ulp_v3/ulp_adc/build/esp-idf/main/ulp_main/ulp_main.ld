/* Variable definitions for ESP32ULP linker
 * This file is generated automatically by esp32ulp_mapgen.py utility.
 */

PROVIDE ( ulp_ac = 0x500007c8 );
PROVIDE ( ulp_acl = 0x500007d4 );
PROVIDE ( ulp_ay = 0x500007cc );
PROVIDE ( ulp_az = 0x500007d0 );
PROVIDE ( ulp_azl = 0x500007d8 );
PROVIDE ( ulp_compare_times = 0x50000754 );
PROVIDE ( ulp_comparex = 0x50000034 );
PROVIDE ( ulp_entry = 0x50000000 );
PROVIDE ( ulp_exit = 0x500000b8 );
PROVIDE ( ulp_i2c_read_bit = 0x50000214 );
PROVIDE ( ulp_i2c_read_byte = 0x50000280 );
PROVIDE ( ulp_i2c_start_cond = 0x50000148 );
PROVIDE ( ulp_i2c_stop_cond = 0x500001a8 );
PROVIDE ( ulp_i2c_write_bit = 0x500001e0 );
PROVIDE ( ulp_i2c_write_byte = 0x50000240 );
PROVIDE ( ulp_init_mpu = 0x50000418 );
PROVIDE ( ulp_m_ax = 0x500007e4 );
PROVIDE ( ulp_m_az = 0x500007e8 );
PROVIDE ( ulp_move_flags = 0x50000750 );
PROVIDE ( ulp_moving_times = 0x50000748 );
PROVIDE ( ulp_p_ax = 0x500007dc );
PROVIDE ( ulp_p_az = 0x500007e0 );
PROVIDE ( ulp_read_intro = 0x50000370 );
PROVIDE ( ulp_stack = 0x50000758 );
PROVIDE ( ulp_stackEnd = 0x500007bc );
PROVIDE ( ulp_sysrun_times = 0x5000074c );
PROVIDE ( ulp_wake_up = 0x500000bc );
PROVIDE ( ulp_write8 = 0x50000328 );
